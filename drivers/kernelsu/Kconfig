## drivers/kernelsu/Kconfig
```kconfig
menu "KernelSU"

config KSU
	tristate "KernelSU function support"
	default y
	help
	  Enable kernel-level root privileges on Android System.
	  Requires CONFIG_KPROBES for kernel hooking support.
	  To compile as a module, choose M here: the
	  module will be called kernelsu.

config KSU_DEBUG
	bool "KernelSU debug mode"
	depends on KSU
	default n
	help
	  Enable KernelSU debug mode.

config KSU_DISABLE_MANAGER
	bool "Disable KernelSU manager integration"
	depends on KSU
	default n
	help
	  Disable manager APK detection and manager-specific handling.
	  Root will be used in place of manager-only functionality.

config KSU_DISABLE_POLICY
	bool "Disable KernelSU policy profiles"
	depends on KSU
	default n
	help
	  Disable per-app root/non-root profile customization.
	  Escalation will always use the default full root profile, and
	  non-root handling will follow the global umount policy only.

config KSU_ALLOWLIST_WORKAROUND
	bool "KernelSU allowlist workaround"
	depends on KSU
	default n
	help
	  Enable workaround for broken allowlist save

# For easier extern ifdef handling
config KSU_MANUAL_HOOK
	bool "KernelSU manual hook mode."
	depends on KSU && KSU != m
	default y if !KPROBES
	default n
	help
	  Enable manual hook support.

choice
	prompt "KernelSU dynamic hook mode"
	depends on KSU && !KSU_MANUAL_HOOK
	default KSU_KPROBES_HOOK

config KSU_KPROBES_HOOK
	bool "KernelSU tracepoint+kretprobe hook"
	depends on KRETPROBES && KPROBES && HAVE_SYSCALL_TRACEPOINTS
	help
	  Enable KPROBES, KRETPROBES and TRACEPOINT hook for KernelSU core.
	  This should not be used on kernel below 5.10.

config KSU_SYSCALL_TABLE_HOOK
	bool "KernelSU syscall table patching hook"
	depends on ARM64 || X86_64
	help
	  Patch sys_call_table entries directly to hook syscalls without
	  kprobes or tracepoints. Intended for non-GKI kernels where kprobes
	  are unavailable or non-functional.
	  Requires kernel >= 4.17 (pt_regs-based syscall ABI).

endchoice

config KSU_SUSFS
	bool "KernelSU addon - SUSFS"
	depends on KSU
	default n
	help
	  Patch and enable SUSFS (susfs4ksu) support with KernelSU Next.
	  Bridged to susfs via a dedicated prctl kprobe (ksu_susfs tool uses
	  prctl 0xDEADBEEF), since KernelSU Next uses an ioctl supercall and
	  has no native prctl handler. Requires the susfs kernel patch
	  (fs/susfs.c and friends) applied in the kernel tree.

config KSU_SUSFS_SUS_PATH
	bool "Enable to hide suspicious path (NOT recommended)"
	depends on KSU_SUSFS
	default y
	help
	  - Allow hiding the user-defined path and all its sub-paths from
	    various system calls.
	  - tmpfs filesystem is not allowed to be added.
	  - Effective only on zygote spawned user app process.

config KSU_SUSFS_SUS_MOUNT
	bool "Enable to hide suspicious mounts"
	depends on KSU_SUSFS
	default y
	help
	  - Allow hiding user-defined mount paths from
	    /proc/self/[mounts|mountinfo|mountstats].
	  - Mounts made by the ksu domain are forced to the dev name "KSU".

config KSU_SUSFS_SUS_KSTAT
	bool "Enable to spoof suspicious kstat"
	depends on KSU_SUSFS
	default y
	help
	  - Allow spoofing the kstat of user-defined file/directory.
	  - Effective only on zygote spawned user app process.

config KSU_SUSFS_TRY_UMOUNT
	bool "Enable to use ksu's ksu_try_umount"
	depends on KSU_SUSFS
	default y
	help
	  - Allow using ksu_try_umount to umount user-defined mount paths for
	    non-root-access-granted processes.

config KSU_SUSFS_SPOOF_UNAME
	bool "Enable to spoof uname"
	depends on KSU_SUSFS
	default y
	help
	  - Allow spoofing the string returned by the uname syscall.

config KSU_SUSFS_HIDE_KSU_SUSFS_SYMBOLS
	bool "Enable to hide ksu and susfs symbols from /proc/kallsyms"
	depends on KSU_SUSFS
	default y
	help
	  - Automatically hide ksu and susfs symbols from /proc/kallsyms.

config KSU_SUSFS_ENABLE_LOG
	bool "Enable logging susfs log to kernel"
	depends on KSU_SUSFS
	default y
	help
	  - Allow logging susfs log to kernel, uncheck it to completely
	    disable all susfs log.

endmenu
```

## fs/ntfs3/Kconfig
```kconfig
# SPDX-License-Identifier: GPL-2.0-only
config NTFS3_FS
	tristate "NTFS Read-Write file system support"
	select NLS
	help
	  Windows OS native file system (NTFS) support up to NTFS version 3.1.

	  Y or M enables the NTFS3 driver with full features enabled (read,
	  write, journal replaying, sparse/compressed files support).
	  File system type to use on mount is "ntfs3". Module name (M option)
	  is also "ntfs3".

	  Documentation: <file:Documentation/filesystems/ntfs3.rst>

config NTFS3_64BIT_CLUSTER
	bool "64 bits per NTFS clusters"
	depends on NTFS3_FS && 64BIT
	help
	  Windows implementation of ntfs.sys uses 32 bits per clusters.
	  If activated 64 bits per clusters you will be able to use 4k cluster
	  for 16T+ volumes. Windows will not be able to mount such volumes.

	  It is recommended to say N here.

config NTFS3_LZX_XPRESS
	bool "activate support of external compressions lzx/xpress"
	depends on NTFS3_FS
	help
	  In Windows 10 one can use command "compact" to compress any files.
	  4 possible variants of compression are: xpress4k, xpress8k, xpress16k and lzx.
	  If activated you will be able to read such files correctly.

	  It is recommended to say Y here.

config NTFS3_TEXFAT_REDIRECT
	bool "Mount NTFS volumes requested as texfat with ntfs3"
	depends on NTFS3_FS=y
	help
	  Android's vold on Sony devices mounts exFAT volumes with the vendor
	  "texfat" driver and has no NTFS support. With this option, a mount
	  request for "texfat" on a volume whose boot sector identifies it as
	  NTFS is served by ntfs3 instead. exFAT volumes are not affected.

	  Together with a userspace helper that reports NTFS volumes to vold
	  as exFAT, this makes NTFS USB drives and SD cards show up as normal
	  removable storage. Without such a helper this option does nothing.

	  If unsure, say N.

config NTFS3_FS_POSIX_ACL
	bool "NTFS POSIX Access Control Lists"
	# Not ported to Linux 5.4 (get_acl/set_acl and the ACL xattr handlers)
	depends on NTFS3_FS && BROKEN
	select FS_POSIX_ACL
	help
	  POSIX Access Control Lists (ACLs) support additional access rights
	  for users and groups beyond the standard owner/group/world scheme,
	  and this option selects support for ACLs specifically for ntfs
	  filesystems.
	  NOTE: this is linux only feature. Windows will ignore these ACLs.

	  If you don't know what Access Control Lists are, say N.
```
